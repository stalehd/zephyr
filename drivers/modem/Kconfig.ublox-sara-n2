## drivers/modem/Kconfig.ublox-sara-n2
```kconfig
# Kconfig - u-blox SARA R4 driver options

#
# Copyright (c) 2019 Foundries.io
#
# SPDX-License-Identifier: Apache-2.0
#

config MODEM_UBLOX_SARA_N2
	bool "Enable u-blox SARA-N2 NB-IoT modem driver"
	select MODEM_RECEIVER
	select NET_OFFLOAD
	help
	  Choose this setting to enable u-blox SARA-N2 NB-IoT modem
	  driver.

if MODEM_UBLOX_SARA_N2
config MODEM_UBLOX_SARA_N2_RX_STACK_SIZE
	int "Stack size for the u-blox SARA-N2 modem driver RX thread"
	default 1028
	help
	  This stack is used by the u-blox SARA-N2 RX thread.

config MODEM_UBLOX_SARA_N2_RX_WORKQ_STACK_SIZE
	int "Stack size for the u-blox SARA-N2 modem driver work queue"
	default 2048
	help
	  This stack is used by the work queue to pass off net_pkt data
	  to the rest of the network stack, letting the rx thread continue
	  processing data.

config MODEM_UBLOX_SARA_N2_APN
	string "APN for establishing network connection"
	default "mda.ee"
	help
	  This setting is used in the AT+CGDCONT command to set the APN name
	  for the network connection context.  This value is specific to
	  the network provider and may need to be changed.

config MODEM_UBLOX_SARA_N2_MANUAL_MCCMNO
	string "MCC/MNOfor establishing network connection"
	help
	  This setting is used in the AT+COPS command to set the MCC/MNO
	  for the network connection context.  This value is specific to
	  the network provider and may need to be changed if auto is not
	  selected.

config MODEM_UBLOX_SARA_N2_INIT_PRIORITY
	int "u-blox SARA-N2 driver init priority"
	default 80
	help
	  u-blox SARA-N2 device driver initialization priority.
	  Do not mess with it unless you know what you are doing.
	  Note that the priority needs to be lower than the net stack
	  so that it can start before the networking sub-system.

endif # MODEM_UBLOX_SARA_N2
```

## dts/bindings/modem/ublox,sara-n2.yaml
```yaml
#
# Copyright (c) 2019, Telenor Digital AS
#
# SPDX-License-Identifier: Apache-2.0
#

title: u-Blox SARA-N2 modem
version: 0.1

description: >
    This is a representation of the u-Blox SARA-N2 modem.

inherits:
    !include uart-device.yaml

properties:
    compatible:
      constraint: "ublox,sara-n2"

    label:
      category: required
```
